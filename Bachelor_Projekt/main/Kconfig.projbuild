## Bachelor_Projekt/main/Kconfig.projbuild
```kconfig
# put here your custom config value
menu "Wifi Configuration"
	config ESP_WIFI_SSID
	    string "WiFi SSID"
	    default "myssid"
	    help
		SSID (network name) for the example to connect to.
	
	config ESP_WIFI_PASSWORD
	    string "WiFi Password"
	    default "mypassword"
	    help
		WiFi password (WPA or WPA2) for the example to use.
endmenu



menu "MQTT Configuration"

    config BROKER_URI
        string "Broker URL"
        default "mqtts://mqtt.eclipse.org:8883"
        help
            URL of an mqtt broker which this example connects to.

    config BROKER_CERTIFICATE_OVERRIDE
        string "Broker certificate override"
        default ""
        help
            Please leave empty if broker certificate included from a textfile; otherwise fill in a base64 part of PEM
            format certificate

    config BROKER_CERTIFICATE_OVERRIDDEN
        bool
        default y if BROKER_CERTIFICATE_OVERRIDE != ""

    config BROKER_BIN_SIZE_TO_SEND
        # This option is not visible and is used only to set parameters for example tests
        # Here we configure the data size to send and to be expected in the python script
        int
        default 20000

endmenu

menu "OTA Update Configuration"

    config FIRMWARE_UPGRADE_URL
        string "Firmware Upgrade URL"
        default "https://192.168.2.106:8070/hello-world.bin"
        help
            URL of server which hosts the firmware image.

    config SKIP_COMMON_NAME_CHECK
        bool "Skip server certificate CN fieldcheck"
        default n
        help
            This allows you to skip the validation of OTA server certificate CN field.

    config SKIP_VERSION_CHECK
        bool "Skip firmware version check"
        default n
        help
            This allows you to skip the firmware version check.

    config OTA_RECV_TIMEOUT
        int "OTA Receive Timeout"
        default 5000
        help
            Maximum time for reception

endmenu
```
